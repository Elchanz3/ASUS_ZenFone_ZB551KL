/* Copyright (c) 2013, The Linux Foundation. All rights reserved.
 *
 * This program is free software; you can redistribute it and/or modify
 * it under the terms of the GNU General Public License version 2 and
 * only version 2 as published by the Free Software Foundation.
 *
 * This program is distributed in the hope that it will be useful,
 * but WITHOUT ANY WARRANTY; without even the implied warranty of
 * MERCHANTABILITY or FITNESS FOR A PARTICULAR PURPOSE.  See the
 * GNU General Public License for more details.
 */

/*---------------------------------------------------------------------------
 * This file is autogenerated file using gcdb parser. Please do not edit it.
 * Update input XML file to add a new entry or update variable in this file
 * VERSION = "1.0"
 *---------------------------------------------------------------------------*/
&mdss_mdp {
	dsi_ili9881c_720_vid: qcom,mdss_dsi_ili9881c_720p_video {
		qcom,mdss-dsi-panel-name = "ili9881c 720p video mode dsi panel";
		qcom,mdss-dsi-panel-controller = <&mdss_dsi0>;
		qcom,mdss-dsi-panel-type = "dsi_video_mode";
		qcom,mdss-dsi-panel-destination = "display_1";
		qcom,mdss-dsi-panel-framerate = <60>;
		qcom,mdss-dsi-virtual-channel-id = <0>;
		qcom,mdss-dsi-stream = <0>;
		qcom,mdss-dsi-panel-width = <720>;
		qcom,mdss-dsi-panel-height = <1280>;
		qcom,mdss-dsi-h-front-porch = <104>;
		qcom,mdss-dsi-h-back-porch = <52>;
		qcom,mdss-dsi-h-pulse-width = <20>;	//Fix LCM bootlogo disappear issue
		qcom,mdss-dsi-h-sync-skew = <0>;
		qcom,mdss-dsi-v-back-porch = <20>;
		qcom,mdss-dsi-v-front-porch = <20>;
		qcom,mdss-dsi-v-pulse-width = <15>;
		qcom,mdss-dsi-h-left-border = <0>;
		qcom,mdss-dsi-h-right-border = <0>;
		qcom,mdss-dsi-v-top-border = <0>;
		qcom,mdss-dsi-v-bottom-border = <0>;
		qcom,mdss-dsi-bpp = <24>;
		qcom,mdss-dsi-underflow-color = <0xff>;
		qcom,mdss-dsi-border-color = <0>;
		qcom,mdss-dsi-on-command = [
				//#CMD_Page 3
				39 01 00 00 00 00 04 ff 98 81 03
				//gip_1
				15 01 00 00 00 00 02 01 00
				15 01 00 00 00 00 02 02 00
				15 01 00 00 00 00 02 03 56
				15 01 00 00 00 00 02 04 13
				15 01 00 00 00 00 02 05 00
				15 01 00 00 00 00 02 06 06
				15 01 00 00 00 00 02 07 01
				15 01 00 00 00 00 02 08 00
				15 01 00 00 00 00 02 09 30
				15 01 00 00 00 00 02 0a 01
				15 01 00 00 00 00 02 0b 00
				15 01 00 00 00 00 02 0c 30
				15 01 00 00 00 00 02 0d 01
				15 01 00 00 00 00 02 0e 00
				15 01 00 00 00 00 02 0f 18
				15 01 00 00 00 00 02 10 18
				15 01 00 00 00 00 02 11 00
				15 01 00 00 00 00 02 12 00
				15 01 00 00 00 00 02 13 00
				15 01 00 00 00 00 02 14 00
				15 01 00 00 00 00 02 15 00
				15 01 00 00 00 00 02 16 00
				15 01 00 00 00 00 02 17 00
				15 01 00 00 00 00 02 18 00
				15 01 00 00 00 00 02 19 00
				15 01 00 00 00 00 02 1a 00
				15 01 00 00 00 00 02 1b 00
				15 01 00 00 00 00 02 1c 00
				15 01 00 00 00 00 02 1d 00
				15 01 00 00 00 00 02 1e 40
				15 01 00 00 00 00 02 1f c0
				15 01 00 00 00 00 02 20 02
				39 01 00 00 00 00 02 21 05
				15 01 00 00 00 00 02 22 02
				15 01 00 00 00 00 02 23 00
				15 01 00 00 00 00 02 24 86
				15 01 00 00 00 00 02 25 85
				15 01 00 00 00 00 02 26 00
				15 01 00 00 00 00 02 27 00
				15 01 00 00 00 00 02 28 3b
				15 01 00 00 00 00 02 29 03
				15 01 00 00 00 00 02 2a 00
				15 01 00 00 00 00 02 2b 00
				15 01 00 00 00 00 02 2c 00
				15 01 00 00 00 00 02 2d 00
				15 01 00 00 00 00 02 2e 00
				15 01 00 00 00 00 02 2f 00
				15 01 00 00 00 00 02 30 00
				39 01 00 00 00 00 02 31 00
				15 01 00 00 00 00 02 32 00
				15 01 00 00 00 00 02 33 00
				15 01 00 00 00 00 02 34 00
				15 01 00 00 00 00 02 35 00
				15 01 00 00 00 00 02 36 00
				15 01 00 00 00 00 02 37 00
				15 01 00 00 00 00 02 38 00
				15 01 00 00 00 00 02 39 00
				15 01 00 00 00 00 02 3a 00
				15 01 00 00 00 00 02 3b 00
				15 01 00 00 00 00 02 3c 00
				15 01 00 00 00 00 02 3d 00
				15 01 00 00 00 00 02 3e 00
				15 01 00 00 00 00 02 3f 00
				15 01 00 00 00 00 02 40 00
				39 01 00 00 00 00 02 41 00
				15 01 00 00 00 00 02 42 00
				15 01 00 00 00 00 02 43 00
				15 01 00 00 00 00 02 44 00
				//gip_2
				15 01 00 00 00 00 02 50 01
				39 01 00 00 00 00 02 51 23
				15 01 00 00 00 00 02 52 45
				15 01 00 00 00 00 02 53 67
				15 01 00 00 00 00 02 54 89
				15 01 00 00 00 00 02 55 ab
				15 01 00 00 00 00 02 56 01
				15 01 00 00 00 00 02 57 23
				15 01 00 00 00 00 02 58 45
				15 01 00 00 00 00 02 59 67
				15 01 00 00 00 00 02 5a 89
				15 01 00 00 00 00 02 5b ab
				15 01 00 00 00 00 02 5c cd
				15 01 00 00 00 00 02 5d ef
				//gip_3
				15 01 00 00 00 00 02 5e 11
				15 01 00 00 00 00 02 5f 08
				15 01 00 00 00 00 02 60 00
				39 01 00 00 00 00 02 61 01
				15 01 00 00 00 00 02 62 02
				15 01 00 00 00 00 02 63 02
				15 01 00 00 00 00 02 64 0f
				15 01 00 00 00 00 02 65 0e
				15 01 00 00 00 00 02 66 0d
				15 01 00 00 00 00 02 67 0c
				15 01 00 00 00 00 02 68 02
				15 01 00 00 00 00 02 69 02
				15 01 00 00 00 00 02 6a 02
				15 01 00 00 00 00 02 6b 02
				15 01 00 00 00 00 02 6c 02
				15 01 00 00 00 00 02 6d 02
				15 01 00 00 00 00 02 6e 06
				15 01 00 00 00 00 02 6f 02
				15 01 00 00 00 00 02 70 02
				39 01 00 00 00 00 02 71 02
				15 01 00 00 00 00 02 72 02
				15 01 00 00 00 00 02 73 02
				15 01 00 00 00 00 02 74 02
				15 01 00 00 00 00 02 75 06
				15 01 00 00 00 00 02 76 00
				15 01 00 00 00 00 02 77 01
				15 01 00 00 00 00 02 78 02
				15 01 00 00 00 00 02 79 02
				15 01 00 00 00 00 02 7a 0f
				15 01 00 00 00 00 02 7b 0e
				15 01 00 00 00 00 02 7c 0d
				15 01 00 00 00 00 02 7d 0c
				15 01 00 00 00 00 02 7e 02
				15 01 00 00 00 00 02 7f 02
				15 01 00 00 00 00 02 80 02
				39 01 00 00 00 00 02 81 02
				15 01 00 00 00 00 02 82 02
				15 01 00 00 00 00 02 83 02
				15 01 00 00 00 00 02 84 08
				15 01 00 00 00 00 02 85 02
				15 01 00 00 00 00 02 86 02
				15 01 00 00 00 00 02 87 02
				15 01 00 00 00 00 02 88 02
				15 01 00 00 00 00 02 89 02
				15 01 00 00 00 00 02 8a 02
				//#CMD_Page 4
				39 01 00 00 00 00 04 ff 98 81 04
				15 01 00 00 00 00 02 6c 15
				15 01 00 00 00 00 02 6e 2b
				//[Arima_5816][Raymond]Gamma 2.2 parameter 20151109 begin
				15 01 00 00 00 00 02 6f b3
				15 01 00 00 00 00 02 5c 83
				15 01 00 00 00 00 02 6a fc
				15 01 00 00 00 00 02 31 75
				//[Arima_5816][Raymond]Gamma 2.2 parameter 20151109 end
				15 01 00 00 00 00 02 3a a4
				15 01 00 00 00 00 02 8d 15
				15 01 00 00 00 00 02 87 ba
				15 01 00 00 00 00 02 26 76
				15 01 00 00 00 00 02 b2 d1
				15 01 00 00 00 00 02 b5 06

                 //#CMD_Page 1   
				39 01 00 00 00 00 04 ff 98 81 01
				//[Arima_5816][Raymond]Gamma 2.2 parameter 20151109 begin
				15 01 00 00 00 00 02 22 0a
				15 01 00 00 00 00 02 31 00
				15 01 00 00 00 00 02 53 67   //Fix flicker issue according to Vendor suggestion
				15 01 00 00 00 00 02 55 70
				15 01 00 00 00 00 02 50 af
				15 01 00 00 00 00 02 51 a8
				15 01 00 00 00 00 02 60 30
				//15 01 00 00 00 00 02 61 00
				//15 01 00 00 00 00 02 62 19
				//15 01 00 00 00 00 02 63 10
				15 01 00 00 00 00 02 a0 13
				15 01 00 00 00 00 02 a1 24
				15 01 00 00 00 00 02 a2 31
				15 01 00 00 00 00 02 a3 15
				15 01 00 00 00 00 02 a4 14
				15 01 00 00 00 00 02 a5 28
				15 01 00 00 00 00 02 a6 1a
				15 01 00 00 00 00 02 a7 1d
				15 01 00 00 00 00 02 a8 88
				15 01 00 00 00 00 02 a9 1a
				15 01 00 00 00 00 02 aa 27
				15 01 00 00 00 00 02 ab 6e
				15 01 00 00 00 00 02 ac 1b
				15 01 00 00 00 00 02 ad 19
				15 01 00 00 00 00 02 ae 4e
				15 01 00 00 00 00 02 af 20
				15 01 00 00 00 00 02 b0 27
				15 01 00 00 00 00 02 b1 43
				15 01 00 00 00 00 02 b2 5e
				15 01 00 00 00 00 02 b3 3f
				15 01 00 00 00 00 02 c0 08
				15 01 00 00 00 00 02 c1 29
				15 01 00 00 00 00 02 c2 38
				15 01 00 00 00 00 02 c3 11
				15 01 00 00 00 00 02 c4 18
				15 01 00 00 00 00 02 c5 28
				15 01 00 00 00 00 02 c6 1f
				15 01 00 00 00 00 02 c7 1e
				15 01 00 00 00 00 02 c8 a6
				15 01 00 00 00 00 02 c9 1e
				15 01 00 00 00 00 02 ca 2a
				15 01 00 00 00 00 02 cb 9d
				15 01 00 00 00 00 02 cc 1c
				15 01 00 00 00 00 02 cd 1b
				15 01 00 00 00 00 02 ce 4b
				15 01 00 00 00 00 02 cf 23
				15 01 00 00 00 00 02 d0 27
				15 01 00 00 00 00 02 d1 5f
				15 01 00 00 00 00 02 d2 65
				15 01 00 00 00 00 02 d3 3f
				//[Arima_5816][Raymond]Gamma 2.2 parameter 20151109 end
				//#CMD_Page 2
				//[Arima_5816][Raymond]modify lcm pwm signal frequence to 10kHz begin
				39 01 00 00 00 00 04 ff 98 81 02
				15 01 00 00 00 00 02 06 40
				15 01 00 00 00 00 02 07 0b
				//[Arima_5816][Raymond]modify lcm pwm signal frequence to 10kHz end
				//#CMD_Page 0
				39 01 00 00 00 00 04 ff 98 81 00
				//set Backlight max brightness begin
				//[Arima_5816][Raymond]Fix backlight turn on early than LCD issue 20151014 begin
				//39 01 00 00 00 00 02
				//51 FF
				//[Arima_5816][Raymond]Fix backlight turn on early than LCD issue 20151014 end
				39 01 00 00 00 00 02 53 2C
				39 01 00 00 00 00 03 68 05 00
				//set Backlight max brightness begin
				05 01 00 00 78 00 01 11
				05 01 00 00 14 00 01 29
				05 01 00 00 00 00 01 35
				];
		qcom,mdss-dsi-off-command = [
				05 01 00 00 0a 00 02 28 00
				05 01 00 00 96 00 02 10 00
				];
		qcom,mdss-dsi-on-command-state = "DSI_LP_MODE";
		qcom,mdss-dsi-off-command-state = "DSI_LP_MODE";
		qcom,mdss-dsi-h-sync-pulse = <1>;
		qcom,mdss-dsi-traffic-mode = "burst_mode";
		qcom,mdss-dsi-bllp-eof-power-mode;
		qcom,mdss-dsi-bllp-power-mode;
		qcom,mdss-dsi-lane-0-state;
		qcom,mdss-dsi-lane-1-state;
		qcom,mdss-dsi-lane-2-state;
		qcom,mdss-dsi-lane-3-state;
		qcom,mdss-dsi-panel-timings = [8d 24 19 00 34 34 1d 26 2a 03 04 00];
		qcom,mdss-dsi-t-clk-post = <0x1f>;
		qcom,mdss-dsi-t-clk-pre = <0x2d>;
		qcom,mdss-dsi-bl-min-level = <1>;
		qcom,mdss-dsi-bl-max-level = <3564>; //Modify Max brightness to around 450 nits
		qcom,mdss-dsi-dma-trigger = "trigger_sw";
		qcom,mdss-dsi-mdp-trigger = "none";
		//qcom,mdss-dsi-bl-pmic-control-type = "bl_ctrl_wled";
		qcom,mdss-dsi-bl-pmic-control-type = "bl_ctrl_dcs";
		qcom,mdss-dsi-reset-sequence = <1 10>, <0 10>, <1 120>; // changed by Josh, you shouldn't modify it at code..
		qcom,mdss-pan-physical-width-dimension = <69>;
		qcom,mdss-pan-physical-height-dimension = <122>;
//[Arima_5816][LCM][RaymondLin] enable ESD recovery feature begin
//		qcom,esd-check-enabled;
//		qcom,mdss-dsi-panel-status-command = [06 01 00 01 05 00 02 0A 08];
//		qcom,mdss-dsi-panel-status-command-state = "dsi_lp_mode";
//		qcom,mdss-dsi-panel-status-check-mode = "reg_read";
//		qcom,mdss-dsi-panel-status-value = <0x9c>;
//[Arima_5816][LCM][RaymondLin] enable ESD recovery feature end

	};
};
