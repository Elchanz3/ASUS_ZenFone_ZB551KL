/* Copyright (c) 2013-2014, The Linux Foundation. All rights reserved.
 *
 * This program is free software; you can redistribute it and/or modify
 * it under the terms of the GNU General Public License version 2 and
 * only version 2 as published by the Free Software Foundation.
 *
 * This program is distributed in the hope that it will be useful,
 * but WITHOUT ANY WARRANTY; without even the implied warranty of
 * MERCHANTABILITY or FITNESS FOR A PARTICULAR PURPOSE.  See the
 * GNU General Public License for more details.
 */


/dts-v1/;
/include/ "msm8926-v1.dtsi"
// [5816][SI][dicktsai] Add Project define for 5816 on LINUX 20150820 BEGIN
// /include/ "msm8226-720p-mtp.dtsi"
// [5816][SI][dicktsai] 20150820 END
/include/ "msm8226-camera-sensor-mtp.dtsi"
/include/ "msm8226-720p-mtp-arima-5816-er2.dtsi"
/include/ "arima_msm8926-5816-er2.dtsi"

/ {
	model = "Qualcomm MSM 8926 MTP Arima 5816 ER2";
	compatible = "qcom,msm8926-mtp", "qcom,msm8926", "qcom,mtp";
	qcom,board-id = <8 0>;
};

&sdhc_2 {
       qcom,pad-drv-on = <0x7 0x4 0x4>; /* 16mA, 10mA, 10mA */
};
