/* Copyright (c) 2013, The Linux Foundation. All rights reserved.
 *
 * This program is free software; you can redistribute it and/or modify
 * it under the terms of the GNU General Public License version 2 and
 * only version 2 as published by the Free Software Foundation.
 *
 * This program is distributed in the hope that it will be useful,
 * but WITHOUT ANY WARRANTY; without even the implied warranty of
 * MERCHANTABILITY or FITNESS FOR A PARTICULAR PURPOSE.  See the
 * GNU General Public License for more details.
 */

/include/ "dsi-panel-hx8394a-720p-video.dtsi"
/include/ "dsi-panel-nt35590-720p-video.dtsi"
/include/ "dsi-panel-nt35521-720p-video.dtsi"
/include/ "dsi-panel-nt35596-1080p-video.dtsi"
/include/ "dsi-panel-nt35590-720p-cmd.dtsi"
/include/ "dsi-panel-ssd2080m-720p-video.dtsi"
/include/ "dsi-panel-jdi-1080p-video.dtsi"
/*[Arima5908][32703][StevenChen]raymond test LCM driver porting 2014/01/03 begin */
/include/ "dsi-panel-truly-hx8379a-qhd-video.dtsi"
/include/ "dsi-panel-truly-hx8379a-pdp2-qhd-video.dtsi"
/include/ "dsi-panel-truly-hx8379c-fwvga-video.dtsi"
/include/ "dsi-panel-ofilm-hx8379c-fwvga-video.dtsi"
/include/ "dsi-panel-tcl-hx8379c-fwvga-video.dtsi"
/*[Arima5908][32703][StevenChen]raymond test LCM driver porting 2014/01/03 end */
/*[Arima_5816][LCM][RaymondLin] LCM Truly ili9881C driver porting 20150921 begin */
/include/ "dsi-panel-ili9881c-720p-video.dtsi"
/*[Arima_5816][LCM][RaymondLin] LCM Truly ili9881C driver porting 20150921 end */
/*[Arima_5816][LCM][RaymondLin] LCM 2nd source HLT ili9881C driver porting 20151104 begin */
/include/ "dsi-panel-hlt_ili9881c-720p-video.dtsi"
/*[Arima_5816][LCM][RaymondLin] LCM 2nd source HLT ili9881C driver porting 20151104 end */

